## build/Kconfig/Kconfig.shield
```kconfig
osource "e:/nRF/projects/manju_light_bulb/boards/shields/*/Kconfig.shield"
osource "e:/nRF/projects/manju_light_switch/boards/shields/*/Kconfig.shield"
osource "e:/nRF/projects/light_switch_dongle/boards/shields/*/Kconfig.shield"
osource "e:/nRF/projects/dongle_light_bulb/boards/shields/*/Kconfig.shield"
osource "E:/nRF/v1.7.1/nrf/boards/shields/*/Kconfig.shield"
```

## build/Kconfig/Kconfig.shield.defconfig
```kconfig
osource "e:/nRF/projects/manju_light_bulb/boards/shields/*/Kconfig.defconfig"
osource "e:/nRF/projects/manju_light_switch/boards/shields/*/Kconfig.defconfig"
osource "e:/nRF/projects/light_switch_dongle/boards/shields/*/Kconfig.defconfig"
osource "e:/nRF/projects/dongle_light_bulb/boards/shields/*/Kconfig.defconfig"
osource "E:/nRF/v1.7.1/nrf/boards/shields/*/Kconfig.defconfig"
```
